## CMakeLists.txt
```
# SPDX-License-Identifier: Apache-2.0

cmake_minimum_required(VERSION 3.20.0)

find_package(Zephyr REQUIRED HINTS $ENV{ZEPHYR_BASE})

# Override standard Microsemi UART adressing with the on from Future Electronics
#set(DTC_OVERLAY_FILE ${CMAKE_CURRENT_LIST_DIR}/src/ripe.dts)

# include($ENV{ZEPHYR_BASE}/cmake/app/boilerplate.cmake NO_POLICY_SCOPE)
#project(hello_world C ASM)
project(perf_baseline)

# No shared library in Zephyr
add_library(funclib STATIC ${CMAKE_CURRENT_SOURCE_DIR}/src/funclib.c )
target_include_directories(funclib PRIVATE ${CMAKE_CURRENT_SOURCE_DIR}/src )
target_compile_options(funclib PRIVATE "-o0" )

target_sources(app PRIVATE ${CMAKE_CURRENT_SOURCE_DIR}/src/testapp.c )
target_link_libraries(app PRIVATE funclib)
target_include_directories(app PRIVATE ${CMAKE_CURRENT_SOURCE_DIR}/src )
target_compile_options(app PRIVATE "-o0" )
```

## prj.conf
```kconfig
CONFIG_MAIN_STACK_SIZE=4096
CONFIG_IDLE_STACK_SIZE=1024
CONFIG_ISR_STACK_SIZE=4096
CONFIG_INIT_STACKS=y
CONFIG_NEWLIB_LIBC=y
CONFIG_DEBUG=y
CONFIG_SIZE_OPTIMIZATIONS=n
CONFIG_DEBUG_OPTIMIZATIONS=y
CONFIG_NEWLIB_LIBC_FLOAT_PRINTF=y
```

## src/funclib.c
```c
#include<funclib.h>

double func1(double arg1){
   double ratio = 1.25;
   double thresold = 1.0;
   double val = arg1;
   double min = 10000.0;
   int i;

   if (val < min) val = min;

   for ( i = 0; i < 1000; i++){
       val = val / ratio;
       if (val < thresold) 
            break;
       val = val + 1.5;
   }

   return (double)i;
}

double func2(double arg1){
    double ratio = 1.25;
    double thresold = 10000.0;
    double val = arg1;
    double max = 10.0;
    int i;

    if (val > max) val = max;

    for (i = 0; i < 1000; i++){
        val = val * ratio;
        if (val > thresold) break;
        val = val - 1.5;
    }

    return (double)i;
}

double func3(double arg1){
    double val = arg1;

    val = func1(val);
    val = func2(val);

    return val;
}

// Syracuse
double func4(double arg) {
    int val = arg;
    int i = 0;
    while (val != 1) {
        if (val%2) {
            // odd
            val = 3*val+1; 
        } else { 
            val /= 2;
        }
        i++;
    }
    return (double)i;
}
```

## src/funclib.h
```c
#ifndef _TESTAPP_FUNC_LIB_
#define _TESTAPP_FUNC_LIB_

#include<stdint.h>

#define FUNCTION_NUMBER 4

double func1(double arg1);

double func2(double arg1);

double func3(double arg1);
double func4(double arg1);

typedef double(*pdfunc)(double);

typedef struct {
   uint8_t buffer[sizeof(double)];
   pdfunc pfunc;
} buff_ptr_t;

typedef pdfunc dfunctable_t[FUNCTION_NUMBER];

static dfunctable_t ftable = {func1, func2, func3, func4};

#endif
```

## src/testapp.c
```c
#include<funclib.h>
#include<stdio.h>
#include<stdlib.h>

#define MAX_DEPTH 100
#define MAX_CALLS 10000

#define FREQ 25000000.0

double main_func(double, int);
double main_func_rec(double, int, int);


static int depth = 0;
static int callsnb = 0;

inline uint64_t get_mcycle() {
    uint64_t mcycle = 0;
    __asm__ volatile ("csrr %0,mcycle"   : "=r" (mcycle)  );
    return mcycle;
}

void main(void)
{
   // definitions used for measuring execution time
   uint64_t start, end;
   uint64_t total_cycles;

   // arguments
   depth = 12;
   callsnb = 50;
   double value = 63728127;
   double sum = 0.0;

   // sanity checks
   if ((1 > depth) || (MAX_DEPTH < depth)){
      fprintf(stderr,"ERROR: specified depth (%d) is out of allowed range (1-%d)\n", depth, MAX_DEPTH);
      exit(1);
   }
   if ((1 > callsnb) || (MAX_CALLS < callsnb)){
      fprintf(stderr,"ERROR: specified call number (%d) is out of allowed range (1-%d)\n", callsnb, MAX_CALLS);
      exit(1);
   }

   fprintf(stdout,"Begining of execution with depth %d, call number %d, seed value %f\n", depth, callsnb, value);

   start = get_mcycle();

   // main computation loop
   for (int i = 0; i < callsnb; i++)
      sum += main_func_rec(value, 0, 1);

   end = get_mcycle();
   total_cycles = end - start;

   fprintf(stdout,"SUCCESS: computed value %f - duration: %f sec %u cycles\n", sum, total_cycles/FREQ, total_cycles);
}


double main_func_rec(double value, int first_func_call, int curdepth){
   // allocation on stack, trigger canaries
   buff_ptr_t buff_ptr;
   *((double*)buff_ptr.buffer) = 0.0;

   // recusive calls, as to create deep stack
   if (curdepth < depth){
      *((double*)buff_ptr.buffer) += main_func_rec(value, ((first_func_call+1)%FUNCTION_NUMBER), curdepth+1);
   }

    double tmp = main_func(value, first_func_call);

   *((double*)buff_ptr.buffer) +=  tmp;

   return *((double*)buff_ptr.buffer);
}


double main_func(double value, int first_func_call){
   int cur_index;
   buff_ptr_t* heap_mem = NULL;
   double res = 0.0;

   // allocate a buffer + fonction pointer on heap, will test heap memory protection such as heap canaries
   heap_mem = (buff_ptr_t*)malloc(sizeof(buff_ptr_t));
   *((double*)heap_mem->buffer) = 0.0;


   for (int i = 0; i < FUNCTION_NUMBER; i++){
      // hopefully this trick bypasses compiler optimization
      cur_index = (first_func_call + i) % FUNCTION_NUMBER; 

      // should cause an indirect jump, triggering forward-edge CFI
      heap_mem->pfunc = ftable[cur_index];

      //res += ftable[cur_index](value);

      // writing in buffer preceding a pointer should lead to a canary
      *((double*)heap_mem->buffer) += heap_mem->pfunc(value);
   }
   res = *((double*)heap_mem->buffer);

   free(heap_mem);

   return res;
}
```
