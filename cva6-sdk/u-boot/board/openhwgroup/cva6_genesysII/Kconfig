## cva6-sdk/u-boot/board/openhwgroup/cva6_genesysII/Kconfig
```kconfig
if TARGET_OPENHWGROUP_CVA6_GENESYSII

config SYS_BOARD
	default "cva6_genesysII"

config SYS_VENDOR
	default "openhwgroup"

config SYS_CPU
	default "generic"

config SYS_CONFIG_NAME
	default "openhwgroup_cva6_genesysII"

config SYS_TEXT_BASE
	default 0x80200000 if SPL
	default 0x80000000 if !RISCV_SMODE
	default 0x80200000 if RISCV_SMODE && ARCH_RV64I
	default 0x80500000 if RISCV_SMODE && ARCH_RV32I

config SPL_TEXT_BASE
	default 0x08000000

config BOARD_SPECIFIC_OPTIONS # dummy
    def_bool y
    select GENERIC_RISCV

endif
```

## cva6-sdk/u-boot/configs/openhwgroup_cv64a6_genesysII_defconfig
```kconfig
CONFIG_RISCV=y
CONFIG_DEFAULT_DEVICE_TREE="cv64a6_genesysII"
CONFIG_TARGET_OPENHWGROUP_CVA6_GENESYSII=y
CONFIG_ARCH_RV64I=y
CONFIG_RISCV_SMODE=y
CONFIG_OF_BOARD_SETUP=y
CONFIG_BOOTDELAY=5
CONFIG_USE_BOOTCOMMAND=y
CONFIG_BOOTCOMMAND="mmc info; mmc read 90000000 100000 5000; setenv fdt_high 0xffffffffffffffff; bootm 90000000 - $(fdtcontroladdr)"
CONFIG_DISPLAY_CPUINFO=y
CONFIG_SPL_SPI_FLASH_MTD=y
CONFIG_CMD_GPT=y
# CONFIG_RANDOM_UUID is not set
CONFIG_CMD_MMC=y
CONFIG_CMD_MTD=y
CONFIG_CMD_PART=y
CONFIG_OF_EMBED=y
CONFIG_MMC=y
# CONFIG_MMC_WRITE is not set
CONFIG_MMC_SPI=y
CONFIG_DM_MTD=y
CONFIG_MTD_SPI_NAND=y
CONFIG_SPI_FLASH_ATMEL=y
CONFIG_SPI_FLASH_EON=y
CONFIG_SPI_FLASH_GIGADEVICE=y
CONFIG_SPI_FLASH_ISSI=y
CONFIG_SPI_FLASH_MACRONIX=y
CONFIG_SPI_FLASH_SPANSION=y
CONFIG_SPI_FLASH_STMICRO=y
CONFIG_SPI_FLASH_SST=y
CONFIG_SPI_FLASH_WINBOND=y
CONFIG_SPI_FLASH_XMC=y
# CONFIG_SPI_FLASH_USE_4K_SECTORS is not set
CONFIG_SPI_FLASH_MTD=y
CONFIG_SYS_NS16550=y
CONFIG_SPI=y
CONFIG_XILINX_SPI=y
```
